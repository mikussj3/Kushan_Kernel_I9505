## arch/arm/configs/jf_eur_defconfig
```kconfig
# RTCC
# SSWAP
CONFIG_FIX_INACTIVE_RATIO=y
CONFIG_PGTABLE_MAPPING=y
CONFIG_FORCE_DISABLE_FIPS=y
CONFIG_TIGHT_PGDAT_BALANCE=y
CONFIG_CRYPTO_NULL=y
CONFIG_CFG80211_REG_NOT_UPDATED=y
CONFIG_EXTRA_FIRMWARE="audience-es325-fw-eur.bin"

CONFIG_SWAP_ENABLE_READAHEAD=n
CONFIG_DIRECT_RECLAIM_FILE_PAGES_ONLY=y
CONFIG_ZSMALLOC_NEW=y
CONFIG_VNSWAP=y
CONFIG_SEC_NET_FILTER=y
CONFIG_RUNTIME_COMPCACHE=n

# SAMP : HOTNESS
CONFIG_TOUCHSCREEN_ATMEL_MXTS=n
CONFIG_FRONTSWAP=y
CONFIG_INCREASE_MAXIMUM_SWAPPINESS=y
CONFIG_ZSWAP=y
CONFIG_ZRAM=n
# Samsung ODE

CONFIG_MACH_JF_EUR=y

CONFIG_EXTRA_FIRMWARE_DIR="firmware"

CONFIG_SAMP_HOTNESS=y
CONFIG_SWAP=y
```
